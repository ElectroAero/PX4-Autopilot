## src/drivers/joystick_can/Kconfig
```kconfig
menuconfig DRIVERS_JOYSTICK_CAN
	bool "joystick_can"
	default n
	---help---
		Enable support for joycstick_can
```

## src/examples/joycan/Kconfig
```kconfig
menuconfig EXAMPLES_JOYCAN
	bool "joyCAN"
	default n
	---help---
		Enable support for joyCAN
```
